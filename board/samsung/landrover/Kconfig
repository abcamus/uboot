## board/samsung/landrover/Kconfig
```kconfig
if TARGET_LANDROVER

config SYS_BOARD
	default "landrover"

config SYS_VENDOR
	default "samsung"

config SYS_CONFIG_NAME
	default "landrover"

endif
```

## configs/landrover_defconfig
```kconfig
CONFIG_SPL=y
CONFIG_ARM=y
CONFIG_ARCH_EXYNOS=y
CONFIG_TARGET_LANDROVER=y
CONFIG_OF_CONTROL=y
CONFIG_DEFAULT_DEVICE_TREE="exynos4412-landrover"
CONFIG_OF_EMBED=y
CONFIG_SYS_PROMT="LANDROVER"
CONFIG_DEBUG_LL=y
CONFIG_DEBUG_UART_PHYS=0x13820000
CONFIG_DEBUG_UART_8250_FLOW_CONTROL=y

CONFIG_DM=y
CONFIG_DM_SERIAL=y
CONFIG_DM_GPIO=y
```
